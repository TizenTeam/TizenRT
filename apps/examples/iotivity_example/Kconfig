## apps/examples/iotivity_example/Kconfig
```kconfig
#
# For a description of the syntax of this configuration file,
# see kconfig-language at https://www.kernel.org/doc/Documentation/kbuild/kconfig-language.txt
#

config EXAMPLES_IOTIVITY_EXAMPLE
	bool "iotivity_example"
	select ENABLE_IOTIVITY
	default n
	---help---
		Enable the iotivity_example

if EXAMPLES_IOTIVITY_EXAMPLE

config EXAMPLES_IOTIVITY_EXAMPLE_PROGNAME
	string "Program name"
	default "iotivity_example"
	depends on BUILD_KERNEL
	---help---
		This is the name of the program that will be use when the TASH ELF
		program is installed.

endif

config USER_ENTRYPOINT
	string
	default "iotivity_example_main" if ENTRY_IOTIVITY_EXAMPLE
```

## apps/examples/netcat/Kconfig
```kconfig
#
# For a description of the syntax of this configuration file,
# see kconfig-language at https://www.kernel.org/doc/Documentation/kbuild/kconfig-language.txt
#

config EXAMPLES_NETCAT
	bool "\"NetCat, World!\" example"
	default n
	---help---
		Enable the \"NetCat, World!\" example

if EXAMPLES_NETCAT

config EXAMPLES_NETCAT_PROGNAME
	string "Program name"
	default "netcat"
	depends on BUILD_KERNEL
	---help---
		This is the name of the program that will be use when the NSH ELF
		program is installed.

endif

config USER_ENTRYPOINT
	string
	default "netcat_main" if ENTRY_NETCAT
```

## apps/examples/startup/Kconfig
```kconfig
#
# For a description of the syntax of this configuration file,
# see kconfig-language at https://www.kernel.org/doc/Documentation/kbuild/kconfig-language.txt
#

config EXAMPLES_STARTUP
	bool "StartUp example"
	default n
	select ENABLE_IOTJS
	---help---
		Enable the StartUp example

if EXAMPLES_STARTUP

config EXAMPLES_STARTUP_PROGNAME
	string "Program name"
	default "startup"
	depends on BUILD_KERNEL
	---help---
		This is the name of the program that will be use when the NSH ELF
		program is installed.

config EXAMPLES_STARTUP_JS_FILE
	string "Program main file"
	default "/rom/example/index.js"
	---help---
		This is the name of the program that will be use when the NSH ELF
		program is installed.

config EXAMPLES_STARTUP_WIFI
	bool "Connect WiFi"
        select WIFI_MANAGER
	select CONFIG_SCSC_WLAN
        default n
                ---help---
                Enable WiFi on boot

if EXAMPLES_STARTUP_WIFI

config EXAMPLES_STARTUP_WIFI_SSID
	string "wifi ap SSID"
	default "public"

config EXAMPLES_STARTUP_WIFI_PASS
	string "wifi ap password"
	default ""
endif

endif

config USER_ENTRYPOINT
	string
	default "startup_main" if ENTRY_STARTUP
```

## apps/examples/version/Kconfig
```kconfig
#
# For a description of the syntax of this configuration file,
# see kconfig-language at https://www.kernel.org/doc/Documentation/kbuild/kconfig-language.txt
#

config EXAMPLES_VERSION
	bool "\"Version, World!\" example"
	default n
	---help---
		Enable the \"Version, World!\" example

if EXAMPLES_VERSION

config EXAMPLES_VERSION_PROGNAME
	string "Program name"
	default "version"
	depends on BUILD_KERNEL
	---help---
		This is the name of the program that will be use when the NSH ELF
		program is installed.

endif

config USER_ENTRYPOINT
	string
	default "version_main" if ENTRY_VERSION
```

## apps/examples/wifiauto/Kconfig
```kconfig
#
# For a description of the syntax of this configuration file,
# see kconfig-language at https://www.kernel.org/doc/Documentation/kbuild/kconfig-language.txt
#

config EXAMPLES_WIFIAUTO
	bool "WifiAuto Auto Connect example"
	default n
	select ARTIK_SDK
	---help---
		Enable the Wifi Auto Connect example

if EXAMPLES_WIFIAUTO

config EXAMPLES_WIFIAUTO_PROGNAME
	string "Program name"
	default "wifiauto"
	depends on BUILD_KERNEL
	---help---
		This is the name of the program that will be use when the NSH ELF
		program is installed.

endif

config USER_ENTRYPOINT
	string
	default "wifiauto_main" if ENTRY_WIFIAUTO
```
